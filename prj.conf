## prj.conf
```kconfig
CONFIG_GPIO=y
CONFIG_INPUT=y
CONFIG_GPIO_EMUL=y
```

## app.overlay
```dts
#include <zephyr/dt-bindings/input/input-event-codes.h>

/ {
	aliases {
		sw0 = &user_btn;
	};

	gpio_keys {
		compatible = "gpio-keys";

		user_btn: button_0 {
			label = "SW_0";
			gpios = <&gpio0 13 GPIO_ACTIVE_HIGH>;
			zephyr,code = <INPUT_KEY_0>;
		};
	};
};
```

## src/main.c
```c
/*******************************************************************
 * @file main.c
 *
 * @brief Main file.
 * @author João Matheus Nascimento Dias (jmnd@ic.ufal.br)
 * @author José Félix de Oliveira Neto (jfon@ic.ufal.br)
 * @version 0.1
 * @date 26/08/2026
 *******************************************************************/

#include <zephyr/drivers/gpio/gpio_emul.h>
#include <zephyr/drivers/led.h>
#include <zephyr/kernel.h>

#include "board_io.h"

static const struct gpio_dt_spec btn = GPIO_DT_SPEC_GET(BUTTON_NODE, gpios);

int main(void)
{

	int ret;
	int btn_state;

	ret = io_init();
	if (ret < 0) {
		printk("Could not initialize gpios: %d\r\n", ret);
		return ret;
	}

	int button_states[] = {0, 1, 0, 1};

	for (int i = 0; i < 4; i++) {
		ret = gpio_emul_input_set_dt(&btn, button_states[i]);
		if (ret < 0) {
			printk("Could not set button state: %d\r\n", ret);
			return ret;
		}

		btn_state = button_read();
		if (btn_state < 0) {
			printk("Could not read button state: %d\r\n", btn_state);
			return btn_state;
		}

		printk("Button: %d -> ", btn_state);

		ret = led_set(btn_state);
		if (ret < 0) {
			printk("Could not set led: %d\r\n", ret);
			return ret;
		}
		printk("\n");
	}

	return 0;
}
```

## src/board_io.c
```c
#include "board_io.h"
#include <stdbool.h>
#include <zephyr/drivers/gpio.h>

static const struct gpio_dt_spec led = GPIO_DT_SPEC_GET(LED0_NODE, gpios);
static const struct gpio_dt_spec btn = GPIO_DT_SPEC_GET(BUTTON_NODE, gpios);

int io_init(void)
{
	int ret;

	if (!gpio_is_ready_dt(&led)) {
		printk("Led is not ready\r\n");
		return -ENODEV;
	}

	/* Led starts off */
	ret = gpio_pin_configure_dt(&led, GPIO_OUTPUT_INACTIVE);
	if (ret < 0) {
		printk("Could not configure led: %d\r\n", ret);
		return ret;
	}

	if (!gpio_is_ready_dt(&btn)) {
		printk("Button is not ready: %d\r\n", ret);
		return -ENODEV;
	}

	ret = gpio_pin_configure_dt(&btn, GPIO_INPUT);
	if (ret < 0) {
		printk("Can not configure button gpio: %d\r\n", ret);
		return ret;
	}

	return 0;
}

int led_set(bool on)
{
	int ret;

	if (on) {
		ret = gpio_pin_set_dt(&led, 1);

		if (ret < 0) {
			printk("Could not turn on led: %d\r\n", ret);
			return ret;
		}
		printk("LED: 1");
	} else {
		ret = gpio_pin_set_dt(&led, 0);

		if (ret < 0) {
			printk("Could not turn off led: %d\r\n", ret);
			return ret;
		}
		printk("LED: 0");
	}

	return 0;
}

int button_read(void)
{
	return gpio_pin_get_dt(&btn);
}
```

## src/board_io.h
```c
/*******************************************************************
 * @file board_io.h
 *
 * @brief Interface do módulo de entradas/saídas (Atividade-03).
 *******************************************************************/

#ifndef BOARD_IO_H_
#define BOARD_IO_H_

#include <stdbool.h>

#include <zephyr/devicetree.h>

/* O native_sim só declara o LED (alias led0). O botão (alias sw0) precisa
 * vir de um overlay de devicetree criado por você. */
#if !DT_NODE_EXISTS(DT_ALIAS(sw0))
#error "Alias sw0 nao existe: crie um overlay de devicetree descrevendo o botao."
#endif

#define LED0_NODE DT_ALIAS(led0)

#define BUTTON_NODE DT_ALIAS(sw0)

/* Configura LED (saída, iniciando desligado) e botão (entrada), obtidos do
 * devicetree pelos aliases led0 e sw0. Retorna 0 ou errno negativo. */
int io_init(void);

/* Escreve o nível lógico do LED (ativo em alto). Retorna 0 ou errno negativo. */
int led_set(bool on);

/* Lê o botão: 1 pressionado, 0 solto, ou errno negativo. */
int button_read(void);

#endif /* BOARD_IO_H_ */
```
